## test_build/Kconfig/Kconfig.shield
```kconfig
osource "/home/localadmin/Documents/aes_gcm/boards/shields/*/Kconfig.shield"
osource "/home/localadmin/ncs/v2.2.0/nrf/boards/shields/*/Kconfig.shield"
```

## test_build/Kconfig/Kconfig.shield.defconfig
```kconfig
osource "/home/localadmin/Documents/aes_gcm/boards/shields/*/Kconfig.defconfig"
osource "/home/localadmin/ncs/v2.2.0/nrf/boards/shields/*/Kconfig.defconfig"
```
